// simple project using Arduino UNO and VFD (Vacuum Fluorescent Display) module GP1287 256x50px 
// to create Fuel and Coolant Temperature gauges
// inspired by VFD gauges from gen4 Honda Prelude VFD gauges

// created by upir, 2024
// youtube channel: https://www.youtube.com/upir_upir

// YOUTUBE VIDEO: https://youtu.be/Frq_JP1lalE
// Source Files: https://github.com/upiir/arduino_car_vfd_gauges

// Links from the video:
// Do you like this video? You can buy me a coffee ☕: https://www.buymeacoffee.com/upir
// VFD Display module GP1287 256x50px: https://s.click.aliexpress.com/e/_DDyBWhn
// Arduino UNO: https://s.click.aliexpress.com/e/_AXDw1h
// Arduino breadboard prototyping shield: https://s.click.aliexpress.com/e/_ApbCwx
// Jumper Wires: https://s.click.aliexpress.com/e/_DF9YbSV
// Image2cpp (convert image to c-style array): https://javl.github.io/image2cpp/
// Photopea (online graphics editor like Photoshop): https://www.photopea.com/
// Clock Project from Mirko Pavleski: https://www.hackster.io/mircemk/simple-esp8266-ntp-clock-on-vfd-display-vfd256x50-gp1287-e0187a
// u8x8 display setup: https://github.com/olikraus/u8g2/wiki/u8x8setupcpp#gp1287ai-256x50
// u8g2 documentation: https://github.com/olikraus/u8g2/wiki/u8g2reference
// Short video showing the original gauges functioning: https://www.youtube.com/watch?v=aR26a9z75Vo
// Someone recreating Honda gauges with LCD: https://honda-tech.com/forums/honda-prelude-4/4th-gen-lude-digi-fuel-temp-gauge-problem-2735099/page3/#post52555969
// Transparent VFD Clock: https://s.click.aliexpress.com/e/_DcGebkt
// VFD Clock: https://s.click.aliexpress.com/e/_DEBzER7

// Related videos:
// VFD clock and character display: https://youtu.be/g7SOxzKatCc
// 3D on the VFD character display: https://youtu.be/IvMauAxWPkQ
// Arduino dashboard with OBDII: https://youtu.be/L3ufJTFX2v0
// Digifiz Nextion dashboard: https://youtu.be/XtSo1BaJ6Bg
// DWIN display gauges: https://youtu.be/ugS3rKBZVVc
// Arduino Gear Indicator: https://www.youtube.com/playlist?list=PLjQRaMdk7pBb6r6xglZb92DGyWJTgBVaV
// Temperature gauge: https://youtu.be/A00CvNi1rzQ
// Pitch and roll indicator: https://youtu.be/GosqWcScwC0
// Boost gauge: https://youtu.be/cZTx7T9uwA4
// Pitch and Roll with Nextion display: https://youtu.be/S_ppdbb0poQ
// Parking sensor: https://youtu.be/gg08H-6Z1Lo
// Speedometer: https://youtu.be/dSD02o3M2sw
// Boost gauge with OLED: https://youtu.be/JXmw1xOlBdk



#include <Arduino.h> // including this is probably not needed, but it should not hurt
#include <U8g2lib.h> // u8g2 library is used to draw images on the display
#include <Wire.h> // library required for IIC communication

// connection between the VFD display module and Arduino UNO
//              
//  CN7      VFD Display ─► Arduino UNO       
//  ┌───┐       
//  │ 6 ├──► FILAMENT_EN ─► 5V / 3.3V (This should be always in the high state)
//  │ 5 ├──► VFD_SCK     ─► pin 13 (HW SPI Clock)
//  │ 4 ├──► VFD_CS      ─► pin 10 (SPI Chip Select)
//  │ 3 ├──► VFD_SDA     ─► pin 11 (HW SPI Data)
//  │ 2 ├──► VFD_RESET   ─► pin 8 (Reset)
//  │ 1 ├──► GND         ─► GND (It´s usually a good idea to share a common ground)
//  └───┘       
//        

U8G2_GP1287AI_256X50_2_4W_HW_SPI u8g2(U8G2_R0, /* cs=*/10, /* dc=*/U8X8_PIN_NONE, /* reset=*/8); // display initiliazation

// fullscreen background image created in Photopea and generated from the image2cpp website

// 'PHOTOPEA_vfd_gauges_256x50px', 256x50px
const unsigned char epd_bitmap_PHOTOPEA_vfd_gauges_256x50px [] PROGMEM = {
	0x00, 0x00, 0x00, 0x00, 0x00, 0x00, 0x00, 0x00, 0x00, 0x00, 0x00, 0x00, 0x00, 0x00, 0x00, 0x00, 
	0x00, 0x00, 0x00, 0x00, 0x00, 0x00, 0x00, 0x00, 0x00, 0x00, 0x00, 0x00, 0x00, 0x00, 0x00, 0x00, 
	0x00, 0x00, 0x00, 0x00, 0x00, 0x00, 0x00, 0x00, 0x00, 0x00, 0x00, 0x00, 0x00, 0x00, 0x00, 0x00, 
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	0x00, 0x00, 0x00, 0x00, 0x00, 0x00, 0x00, 0x00, 0x00, 0x00, 0x00, 0x00, 0x00, 0x00, 0x00, 0x00
};

int fuel_value = 0; // fuel state 0-120
int fuel_value_inc = 1; // fuel value increment

int temp_value = 80; // fuel state 0-120
int temp_value_inc = -1; // temperature value increment


void setup(void) {
  u8g2.begin(); // start the u8g2 library
  u8g2.setContrast(255); // set the maximum brightness of the display

  // draw background fullscreen image - only once
  // this is needed because in the main loop, we only redraw the top part of the screen to maximize performance
  u8g2.firstPage(); // this loop is needed for the u8g2 page mode
  do {
     u8g2.setDrawColor(1); // white color
     u8g2.drawXBMP(0, 0, 256, 50, epd_bitmap_PHOTOPEA_vfd_gauges_256x50px); // draw fullscreen image generated by image2cpp website
  } while ( u8g2.nextPage() );

}

int current_page = 0; // keep track of current page, since we only want to redraw the top portion of the display = only the first page

void loop(void) {

  // animate the fuel gauge in the ping-pong motion
  fuel_value = fuel_value + fuel_value_inc;
  if ((fuel_value >= 120) && (fuel_value_inc > 0)) {
    fuel_value_inc = -1;
  } else if ((fuel_value <= 0) && (fuel_value_inc < 0)) {
    fuel_value_inc = 1;
  }

  // animate the temperature gauge in the ping-pong motion
  temp_value = temp_value + temp_value_inc;
  if ((temp_value >= 120) && (temp_value_inc > 0)) {
    temp_value_inc = -1;
  } else if ((temp_value <= 0) && (temp_value_inc < 0)) {
    temp_value_inc = 1;
  }  


  u8g2.firstPage(); // needed for the u8g2 page mode
  current_page = 0; // keep track of current page
  do {

     if (current_page >= 1) {break;} // if we are on any other page other than page 0, we don´t need to draw anything, just skip it

     u8g2.setDrawColor(1); // draw in white color
     u8g2.drawXBMP(0, 0, 256, 50, epd_bitmap_PHOTOPEA_vfd_gauges_256x50px); // draw fullscreen image generated by image2cpp website

     u8g2.setDrawColor(0); // draw in black color
     u8g2.drawBox(5 + fuel_value, 2, 120 - fuel_value, 13); // draw black filled box to cover the fuel gauge
     u8g2.drawBox(131 + temp_value, 2, 120 - temp_value, 13); // draw black filled box to cover the temperature gauge

     current_page++; // increase the current page counter

  } while ( u8g2.nextPage() ); // this is required for the u8g2 page mode
  
}
